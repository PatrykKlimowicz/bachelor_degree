## meta-custom/meta-bachelor/conf/layer.conf
```bitbake
BBPATH := "${BBPATH}:${LAYERDIR}" 
LAYERSERIES_COMPAT_bachelor="thud"
LCONF_VERSION = "7"
# We have a packages directory, add to BBFILES 
BBFILES := "${BBFILES} ${LAYERDIR}/recipes-*/*/*.bb \ 
            ${LAYERDIR}/recipes-*/*/*.bbappend" 

BBFILE_COLLECTIONS += "bachelor" 
BBFILE_PATTERN_bachelor := "^${LAYERDIR}/" 
BBFILE_PRIORITY_bachelor := "4"
```

## meta-hello-spi/conf/layer.conf
```bitbake
BBPATH := "${BBPATH}:${LAYERDIR}" 
LAYERSERIES_COMPAT_hello-spi="thud"
LCONF_VERSION = "7"
# We have a packages directory, add to BBFILES 
BBFILES := "${BBFILES} ${LAYERDIR}/recipes-*/*/*.bb \ 
            ${LAYERDIR}/recipes-*/*/*.bbappend" 

BBFILE_COLLECTIONS += "hello-spi" 
BBFILE_PATTERN_hello-spi := "^${LAYERDIR}/" 
BBFILE_PRIORITY_hello-spi := "4"
```

## meta-helloworld/conf/layer.conf
```bitbake
BBPATH := "${BBPATH}:${LAYERDIR}" 
LAYERSERIES_COMPAT_helloworld="thud"
LCONF_VERSION = "7"
# We have a packages directory, add to BBFILES 
BBFILES := "${BBFILES} ${LAYERDIR}/recipes-*/*/*.bb \ 
            ${LAYERDIR}/recipes-*/*/*.bbappend" 

BBFILE_COLLECTIONS += "helloworld" 
BBFILE_PATTERN_helloworld := "^${LAYERDIR}/" 
BBFILE_PRIORITY_helloworld := "4"
```
